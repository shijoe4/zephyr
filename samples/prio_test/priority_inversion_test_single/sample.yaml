## samples/prio_test/priority_inversion_test_single/sample.yaml
```yaml
sample:
  description: A basic Constant Bandwidth Server sample
  name: basic CBS sample
common:
  tags:
    - CBS
tests:
  sample.cbs.simple:
    build_only: true
    platform_allow:
      - qemu_riscv32
      - qemu_cortex_a53
      - rpi_pico
      - qemu_riscv32
      - qemu_x86_64
    integration_platforms:
      - qemu_riscv32
      - rpi_pico
      - qemu_x86_64
    tags: cbs
```
