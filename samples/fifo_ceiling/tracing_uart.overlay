/* tracing_uart.overlay */

/ {
    chosen {
        /* Set the UART used for tracing */
            /*zephyr_tracing_uart = &uart0;*/
        zephyr,tracing-uart = &uart0;
    };
};

 &uart0 {
    status = "okay";
};
